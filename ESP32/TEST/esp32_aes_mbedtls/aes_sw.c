
#include "aes_sw.h"
//#include "Arduino.h"

#include <inttypes.h>
#include <string.h>
#include <stdio.h>
#include <stdlib.h>
#include <math.h>

void printBits(size_t size, void * ptr);
static void bit_xor(uint8_t *Z, uint8_t *V);

/***************************************************************************//**
 * Lookuptables and constants
 ******************************************************************************/

 //lookup table of sbox
 const uint8_t LUT[256] = {
 	0x63, 0x7c, 0x77, 0x7b, 0xf2, 0x6b, 0x6f, 0xc5, 0x30, 0x01, 0x67, 0x2b, 0xfe, 0xd7, 0xab, 0x76,
 	0xca, 0x82, 0xc9, 0x7d, 0xfa, 0x59, 0x47, 0xf0, 0xad, 0xd4, 0xa2, 0xaf, 0x9c, 0xa4, 0x72, 0xc0,
 	0xb7, 0xfd, 0x93, 0x26, 0x36, 0x3f, 0xf7, 0xcc, 0x34, 0xa5, 0xe5, 0xf1, 0x71, 0xd8, 0x31, 0x15,
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 	0x8c, 0xa1, 0x89, 0x0d, 0xbf, 0xe6, 0x42, 0x68, 0x41, 0x99, 0x2d, 0x0f, 0xb0, 0x54, 0xbb, 0x16
 	};

 //lookup table of inverse sbox
 const uint8_t LUT_INVERSE[] = {
 	0x52, 0x09, 0x6A, 0xD5, 0x30, 0x36, 0xA5, 0x38, 0xBF, 0x40, 0xA3, 0x9E, 0x81, 0xF3, 0xD7, 0xFB,
 	0x7C, 0xE3, 0x39, 0x82, 0x9B, 0x2F, 0xFF, 0x87, 0x34, 0x8E, 0x43, 0x44, 0xC4, 0xDE, 0xE9, 0xCB,
 	0x54, 0x7B, 0x94, 0x32, 0xA6, 0xC2, 0x23, 0x3D, 0xEE, 0x4C, 0x95, 0x0B, 0x42, 0xFA, 0xC3, 0x4E,
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 	0x17, 0x2B, 0x04, 0x7E, 0xBA, 0x77, 0xD6, 0x26, 0xE1, 0x69, 0x14, 0x63, 0x55, 0x21, 0x0C, 0x7D
 };

 /**	Lookup tables for GF field multiplication, saves time and reduces power leakage */

 const uint8_t LUT_X_09[256]={
 	0x00,0x09,0x12,0x1b,0x24,0x2d,0x36,0x3f,0x48,0x41,0x5a,0x53,0x6c,0x65,0x7e,0x77,
 	0x90,0x99,0x82,0x8b,0xb4,0xbd,0xa6,0xaf,0xd8,0xd1,0xca,0xc3,0xfc,0xf5,0xee,0xe7,
 	0x3b,0x32,0x29,0x20,0x1f,0x16,0x0d,0x04,0x73,0x7a,0x61,0x68,0x57,0x5e,0x45,0x4c,
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 	0x31,0x38,0x23,0x2a,0x15,0x1c,0x07,0x0e,0x79,0x70,0x6b,0x62,0x5d,0x54,0x4f,0x46
 };
 const uint8_t LUT_X_B[256]={
 	0x00,0x0b,0x16,0x1d,0x2c,0x27,0x3a,0x31,0x58,0x53,0x4e,0x45,0x74,0x7f,0x62,0x69,
 	0xb0,0xbb,0xa6,0xad,0x9c,0x97,0x8a,0x81,0xe8,0xe3,0xfe,0xf5,0xc4,0xcf,0xd2,0xd9,
 	0x7b,0x70,0x6d,0x66,0x57,0x5c,0x41,0x4a,0x23,0x28,0x35,0x3e,0x0f,0x04,0x19,0x12,
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 	0xca,0xc1,0xdc,0xd7,0xe6,0xed,0xf0,0xfb,0x92,0x99,0x84,0x8f,0xbe,0xb5,0xa8,0xa3
 };
 const uint8_t LUT_X_D[256]={
 	0x00,0x0d,0x1a,0x17,0x34,0x39,0x2e,0x23,0x68,0x65,0x72,0x7f,0x5c,0x51,0x46,0x4b,
 	0xd0,0xdd,0xca,0xc7,0xe4,0xe9,0xfe,0xf3,0xb8,0xb5,0xa2,0xaf,0x8c,0x81,0x96,0x9b,
 	0xbb,0xb6,0xa1,0xac,0x8f,0x82,0x95,0x98,0xd3,0xde,0xc9,0xc4,0xe7,0xea,0xfd,0xf0,
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 	0xdc,0xd1,0xc6,0xcb,0xe8,0xe5,0xf2,0xff,0xb4,0xb9,0xae,0xa3,0x80,0x8d,0x9a,0x97
 };
 const uint8_t LUT_X_E[256]={
 	0x00,0x0e,0x1c,0x12,0x38,0x36,0x24,0x2a,0x70,0x7e,0x6c,0x62,0x48,0x46,0x54,0x5a,
 	0xe0,0xee,0xfc,0xf2,0xd8,0xd6,0xc4,0xca,0x90,0x9e,0x8c,0x82,0xa8,0xa6,0xb4,0xba,
 	0xdb,0xd5,0xc7,0xc9,0xe3,0xed,0xff,0xf1,0xab,0xa5,0xb7,0xb9,0x93,0x9d,0x8f,0x81,
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 	0xd7,0xd9,0xcb,0xc5,0xef,0xe1,0xf3,0xfd,0xa7,0xa9,0xbb,0xb5,0x9f,0x91,0x83,0x8d
 };

 //round coeffient
 uint8_t RCoe[10] = {0x1, 0x2, 0x4, 0x8, 0x10, 0x20, 0x40, 0x80, 0x1b, 0x36};

/*
* /brief subtitute every byte with the corresponding one in LUT
* /para *buffer - actual message to be subtituted
* /return void
*/
void SubBytes_128(uint8_t *buffer)
{
	//substitute every byte
	for(uint8_t i = 0; i < 16; i++)
 		buffer[i] = LUT[buffer[i]];
}

 /*
 * /brief subtitute every byte with the corresponding one in LUT
 * /para *buffer - actual message to be subtituted
 * /return void
 */
 void SubBytesInverse_128(uint8_t *buffer)
 {
 	//substitute every byte
 	for(uint8_t i = 0; i < 16; i++)
 		buffer[i] = LUT_INVERSE[buffer[i]];
 }

/*
* /brief shift rows of the input matrix, with the offset 0, 1, 2, 3
* /para *buffer - actual message to be shifted
* /return void
*/
void ShiftRows_128(uint8_t *buffer)
{
	//converrt the 8bit pointer to 32bit
	uint32_t *temp_buffer = (uint32_t *)buffer;

	//shift second row with offset 1 byte
	temp_buffer[1] = (temp_buffer[1] >> 8) + (temp_buffer[1] << 24);
	//shift third row with offset 2 byte
	temp_buffer[2] = (temp_buffer[2] >> 16) + (temp_buffer[2] << 16);
	//shift fourth row with offset 3 byte
	temp_buffer[3] = (temp_buffer[3] >> 24) + (temp_buffer[3] << 8);
}

 /*
 * /brief shift rows of the input matrix, with the offset 0, 3, 2, 1
 * /para *buffer - actual message to be shifted
 * /return void
 */
 void ShiftRowsInverse_128(uint8_t *buf)
 {
	//converrt the 8bit pointer to 32bit
	uint32_t *temp_buffer = (uint32_t *)buf;

	//shift second row with offset 3 byte
	temp_buffer[1] = (temp_buffer[1] >> 24) + (temp_buffer[1] << 8);
	//shift third row with offset 2 byte
	temp_buffer[2] = (temp_buffer[2] >> 16) + (temp_buffer[2] << 16);
	//shift fourth row with offset 1 byte
	temp_buffer[3] = (temp_buffer[3] >> 8) + (temp_buffer[3] << 24);
 }

 // The following xtime_E, xtime_B, xtime_D, xtime_9 are derived using xtime()
 // reference: https://www.usenix.org/legacy/publications/library/proceedings/cardis02/full_papers/valverde/valverde_html/node15.html
 uint8_t xtime_E(uint8_t in_data)
 {
 	uint8_t out_data = 0;

 	uint8_t temp_xtime = xtime(in_data);
 	uint8_t temp_xtime_2 = xtime(temp_xtime);
 	uint8_t temp_xtime_3 = xtime(temp_xtime_2);

 	out_data = temp_xtime ^ temp_xtime_2 ^ temp_xtime_3;

 	return out_data;
 }

 uint8_t xtime_B(uint8_t in_data)
 {
 	uint8_t out_data = 0;

    uint8_t temp_xtime = xtime(in_data);
 	uint8_t temp_xtime_2 = xtime(temp_xtime);
 	uint8_t temp_xtime_3 = xtime(temp_xtime_2);

 	out_data = in_data ^ temp_xtime ^  temp_xtime_3;

 	return out_data;
 }

 uint8_t xtime_D(uint8_t in_data)
 {
 	uint8_t out_data = 0;

 	uint8_t temp_xtime = xtime(in_data);
 	uint8_t temp_xtime_2 = xtime(temp_xtime);
 	uint8_t temp_xtime_3 = xtime(temp_xtime_2);

 	out_data = in_data ^ temp_xtime_2 ^ temp_xtime_3;

 	return out_data;
 }

 uint8_t xtime_9(uint8_t in_data)
 {
 	uint8_t out_data = 0;

     uint8_t temp_xtime = xtime(in_data);
 	uint8_t temp_xtime_2 = xtime(temp_xtime);
 	uint8_t temp_xtime_3 = xtime(temp_xtime_2);

 	out_data = in_data ^ temp_xtime_3;

 	return out_data;
 }

/*
* /brief compute mixcolumns matrix
* /para *buffer - actual state to be computed
* /return void
*/
void MixColumns_128(uint8_t *buffer)
{
	//temporal array to save calculated data
	uint8_t temp_mc[16] = {0};

	//compute every mixcolumn of every element
	for(uint8_t i = 0; i < 16; i++)
 	{
 		temp_mc[i] ^= xtime(buffer[i]) ^ xtime(buffer[(4+i)%16]) ^ buffer[(4+i)%16] ^ buffer[(8+i)%16] ^ buffer[(12+i)%16];
 	}

	//update calculated data in buffer
	memcpy(buffer, temp_mc, 16);
}

 /*
 * /brief compute inverse mixcolumns matrix (E,B,D,9; 9,E,B,D; D,9,E,B; B,D,9,E)
 * /para *buffer - actual state to be computed
 * /return void
 */
 void MixColumnsInverse_128(uint8_t *buffer)
 {
 	//temporal array to save calculated data
 	uint8_t temp_mc[16] = {0};

 	//compute every mixcolumn of every element
 	for(uint8_t i = 0; i < 16; i++)
 	{
 		temp_mc[i] ^= xtime_E(buffer[i]) ^ xtime_B(buffer[(4+i)%16]) ^ xtime_D(buffer[(8+i)%16]) ^ xtime_9(buffer[(12+i)%16]);
 	}

 	//update calculated data in buffer
 	memcpy(buffer, temp_mc, 16);
 }

 /*
 * /brief XOR of the input state and actual key
 * /para *buffer - actual state to be computed
 *		*param - actual key
 * /return void
 */
 void AddRoundKey_128(uint8_t *buffer, uint8_t *param)
 {
 	for(uint8_t i = 0; i < 16; i++)
 	{
 		buffer[i] ^= param[i];
 	}
 }

 /*
 * /brief update round key
 * /para *param - actual key
 *		i_round - actual round number
 * /return void
 */
 void update_RoundKey(uint8_t *param, uint8_t i_round)
 {
 	//temporal array to save the last column
 	uint8_t temp_key_row[4] = {0};

 	//shift the last column up with offset 1 and meantime substitute corresponding byte
 	temp_key_row[0] = LUT[param[7]];
 	temp_key_row[1] = LUT[param[11]];
 	temp_key_row[2] = LUT[param[15]];
 	temp_key_row[3] = LUT[param[3]];

 	//XOR first byte of this word with round coeffient
 	temp_key_row[0] ^= RCoe[i_round-1];

 	//xor the first column key
 	param[0] ^= temp_key_row[0];
 	param[4] ^= temp_key_row[1];
 	param[8] ^= temp_key_row[2];
 	param[12] ^= temp_key_row[3];
 	//xor the second column key
 	param[1] ^= param[0];
 	param[5] ^= param[4];
 	param[9] ^= param[8];
 	param[13] ^= param[12];
 	//xor the third column key
 	param[2] ^= param[1];
 	param[6] ^= param[5];
 	param[10] ^= param[9];
 	param[14] ^= param[13];
 	//xor the fourth column key
 	param[3] ^= param[2];
 	param[7] ^= param[6];
 	param[11] ^= param[10];
 	param[15] ^= param[14];

 }

void MixColumnsInverse_128_LUT(uint8_t *buffer)
{
	//temporal array to save calculated data
	uint8_t temp_mc[16] = {0};

	//compute every mixcolumn of every element
	for(uint8_t i = 0; i < 16; i++)
	{
		temp_mc[i] ^= LUT_X_E[buffer[i]] ^ LUT_X_B[buffer[(4+i)%16]] ^ LUT_X_D[buffer[(8+i)%16]] ^ LUT_X_09[buffer[(12+i)%16]];
	}

	//update calculated data in buffer
	memcpy(buffer, temp_mc, 16);
}


void aes128_decrypt(uint8_t *in_ciphertext, uint8_t *key, uint8_t *out_plaintext)
{
	// re-arrange 16 bytes ciphertext tableaus
    for(uint8_t i = 0; i < 4; i++)
    {
    	for(uint8_t j = 0; j < 4; j++)
    	{
    		out_plaintext[4 * i + j] = in_ciphertext[i + 4 * j];
    	}
    }

    uint8_t temp_key[16] = {0};
    // re-arrange 16 bytes key tableaus
    for(uint8_t i = 0; i < 4; i++)
    {
    	for(uint8_t j = 0; j < 4; j++)
    	{
    		temp_key[4 * i + j] = key[i + 4 * j];
    	}
    }

	uint8_t round_key[11][16] = {0};
	// copy original key to the first array
	memcpy(round_key[0], temp_key, 16);
	// compute next 10 round keys
	for(uint8_t i = 1; i < 11; i++)
	{
		// compute round key
		update_RoundKey(temp_key, i);

		// store calculated round key to array
		memcpy(round_key[i], temp_key, 16);
	}

	// main loop to decrypt (index from 11 ~ 1)
	AddRoundKey_128(out_plaintext, round_key[10]);
	ShiftRowsInverse_128(out_plaintext);
	SubBytesInverse_128(out_plaintext);

	// main loop to decrypt (index from 11 ~ 1)
	for(uint8_t i = 10; i > 1; i--)
	{
		// xor round key
		AddRoundKey_128(out_plaintext, round_key[i-1]);

		// inverse Mix column for round 2 to 10
		MixColumnsInverse_128(out_plaintext);
		// inverse shift rows
		ShiftRowsInverse_128(out_plaintext);
		// inverse substitute byte
		SubBytesInverse_128(out_plaintext);

	}

	// last round
	AddRoundKey_128(out_plaintext, round_key[0]);

	uint8_t temp[16];
    //transfer message tableau back to memory alignment
    for(uint8_t i = 0; i < 4; i++)
    {
    	for(uint8_t j = 0; j < 4; j++)
    	{
    		temp[4 * i + j] = out_plaintext[i + 4 * j];
    	}
    }

    //copy data from temp to temp_plainntext
    memcpy(out_plaintext, temp, 16);

}

void aes128_encrypt(uint8_t *in_plaintext, uint8_t *key, uint8_t *out_ciphertext)
{

	uint8_t temp_key[16] = {0};
	for(uint8_t i = 0; i < 4; i++)
		for(uint8_t j = 0; j < 4; j++)
			temp_key[4*i+j] = key[i+4*j];


	for(uint8_t i = 0; i < 4; i++)
		for(uint8_t j = 0; j < 4; j++)
			out_ciphertext[4*i+j] = in_plaintext[i+4*j];

	//encrypt input message in 11 rounds
	for(uint8_t round_count = 0; round_count < 11; round_count++)
	{
        if(round_count > 0)
        {
        	//update round key before encryption. 
			update_RoundKey(temp_key, round_count);

        	SubBytes_128(out_ciphertext);
        	ShiftRows_128(out_ciphertext);

        	//not needed for last round
        	if(round_count < 10)
        		MixColumns_128(out_ciphertext);
        }
        
        //needed for every round
        AddRoundKey_128(out_ciphertext, temp_key);
	}

	uint8_t temp[16];
    //transfer message tableau back to memory alignment
	for(uint8_t i = 0; i < 4; i++)
		for(uint8_t j = 0; j < 4; j++)
			temp[4*i+j] = out_ciphertext[i+4*j];


    //copy data from temp to msg
    memcpy(out_ciphertext, temp, 16);  
}


void aes128_gcm_encrypt(uint8_t *in_plaintext, uint32_t in_plaintext_len, uint8_t *key, uint8_t *iv, uint8_t *aad, uint32_t aad_len, uint8_t *out_ciphertext, uint8_t *out_tag)
{
	///
	uint8_t H[16];
	uint8_t zero_array[16] = {0};
	aes128_encrypt(zero_array, key, H);
	//aes128_hw_acce_encrypt(zero_array, key, H);

	// iv_counter is combined by iv and 32-bit counter
	uint8_t iv_counter[16] = {0};
	memcpy(iv_counter, iv, 12);
	iv_counter[15] = 1;

	// used for calculating authentication tag in last block
	uint8_t temp_tag[16];
	aes128_encrypt(iv_counter, key, temp_tag);
	//aes128_hw_acce_encrypt(iv_counter, key, temp_tag);

	// Both pointers used to point to the current position to process
	uint8_t *temp_plaintext = in_plaintext;
	uint8_t *temp_ciphertext = out_ciphertext;

	// 
	uint8_t intermediate_hash[16] = {0};
	
	if(aad_len > 0)
	{
		uint8_t temp_block_aad[16] = {0};
		
		for(uint8_t i = 0; i < aad_len/16; i++)
		{
			uint8_t temp_intermediate_hash[16];

			memcpy(temp_block_aad, aad+16*i, 16);
			bit_xor(intermediate_hash, temp_block_aad);
			gcm_mult(intermediate_hash, H,  temp_intermediate_hash);
			memcpy(intermediate_hash, temp_intermediate_hash, 16);
		}

		if(aad_len > 16*(aad_len/16))
		{
			uint8_t temp_intermediate_hash[16];

			memset(temp_block_aad, 0, 16);
			memcpy(temp_block_aad, aad+16*(aad_len/16), aad_len - 16*(aad_len/16));
			bit_xor(intermediate_hash, temp_block_aad);
			gcm_mult(intermediate_hash, H,  temp_intermediate_hash);
			memcpy(intermediate_hash, temp_intermediate_hash, 16);
		}
	}
	else
	{
		uint8_t temp_intermediate_hash[16];

		gcm_mult(intermediate_hash, H,  temp_intermediate_hash);
		memcpy(intermediate_hash, temp_intermediate_hash, 16);
	}
	
	printf("\nX_0:");
	for(uint8_t i = 0; i < 16; i++)
		printf("%02X ", intermediate_hash[i]);

	for(uint8_t block_nr = 0; block_nr < in_plaintext_len/16; block_nr++)
	{
		iv_counter[15]++;

		// encrypt IV
		aes128_encrypt(iv_counter, key, temp_ciphertext);
		//aes128_hw_acce_encrypt(iv_counter, key, temp_ciphertext);

		// xor plaintext block with the above temporary ciphertext
		for(uint8_t i = 0; i < 16; i++)
			temp_ciphertext[i] ^= temp_plaintext[i];


		for(uint8_t j = 0; j < 16; j++)
		  intermediate_hash[j] ^= temp_ciphertext[j];

		uint8_t temp_intermediate_hash[16];
		gcm_mult(intermediate_hash, H,  temp_intermediate_hash);
		memcpy(intermediate_hash, temp_intermediate_hash, 16);
		printf("\nmult_%d: ", block_nr+1);
		for(uint8_t k = 0; k < 16; k++)
      		  printf("%2X ", intermediate_hash[k]);


		// move pointere to next 16-byte block
		temp_plaintext += 16;
		temp_ciphertext += 16;
	}

	// Check, if there exists some bytes (len < 16) needs to be encrypted
	uint8_t remaining_bytes = in_plaintext_len - 16 * (in_plaintext_len/16);
	if(remaining_bytes > 0)
	{
		iv_counter[15]++;

		uint8_t last_block_temp_ciphertext[16];
		// encrypt IV
		aes128_encrypt(iv_counter, key, last_block_temp_ciphertext);
		//aes128_hw_acce_encrypt(iv_counter, key, last_block_temp_ciphertext);

		// xor plaintext block with the above temporary ciphertext
		for(uint8_t i = 0; i < remaining_bytes; i++)
			temp_ciphertext[i] = last_block_temp_ciphertext[i] ^ temp_plaintext[i];

		for(uint8_t i = 0; i < 16; i++)
		{
			if(i < remaining_bytes)
				intermediate_hash[i] ^= temp_ciphertext[i];
			else
				intermediate_hash[i] ^= 0;
		}	

		uint8_t temp_intermediate_hash[16];
		gcm_mult(intermediate_hash, H,  temp_intermediate_hash);

		memcpy(intermediate_hash, temp_intermediate_hash, 16);
		printf("\nmult_last: ");
		for(uint8_t i = 0; i < 16; i++)
			printf("%2X ", intermediate_hash[i]);	
	}

	uint64_t len_A = aad_len * 8;
	uint64_t len_C = in_plaintext_len * 8;

	uint8_t temp_len_A_C[16];
	for(uint8_t i = 0 ; i < 8; i++)
		temp_len_A_C[i] = (uint8_t)(len_A >> (8*(7-i)));
	for(uint8_t i = 8 ; i < 16; i++)
		temp_len_A_C[i] = (uint8_t)(len_C >> (8*(15-i)));

	printf("\n len_AC: ");
	for(uint8_t i = 0; i < 16; i++)
	{
		intermediate_hash[i] ^= temp_len_A_C[i];
		printf("%2X ", temp_len_A_C[i]);
	}
		
	gcm_mult(intermediate_hash, H,  out_tag);
	printf("\nQHASH: ");
	for(uint8_t i = 0; i < 16; i++)
		printf("%2X ", out_tag[i]);

	for(uint8_t i = 0; i < 16; i++)
		out_tag[i] ^= temp_tag[i];
	
}


int aes128_gcm_decrypt(uint8_t *in_ciphertext, uint32_t in_ciphertext_len, uint8_t *key, uint8_t *iv, uint8_t *aad, uint32_t aad_len, uint8_t *in_tag, uint8_t *out_plaintext)
{
	// iv_counter is combined by iv and 32-bit counter
	uint8_t iv_counter[16] = {0};
	memcpy(iv_counter, iv, 12);
	iv_counter[15] = 1;

	//=====================================================================
	uint8_t temp_tag[16];
	aes128_encrypt(iv_counter, key, temp_tag);
	// check authentication tag
	uint8_t H[16];
	uint8_t zero_array[16] = {0};
	aes128_encrypt(zero_array, key, H);

	uint8_t intermediate_hash[16] = {0};
	
	if(aad_len > 0)
	{
		uint8_t temp_block_aad[16] = {0};
		
		for(uint8_t i = 0; i < aad_len/16; i++)
		{
			uint8_t temp_intermediate_hash[16];

			memcpy(temp_block_aad, aad+16*i, 16);
			bit_xor(intermediate_hash, temp_block_aad);
			gcm_mult(intermediate_hash, H,  temp_intermediate_hash);
			memcpy(intermediate_hash, temp_intermediate_hash, 16);
		}

		if(aad_len > 16*(aad_len/16))
		{
			uint8_t temp_intermediate_hash[16];

			memset(temp_block_aad, 0, 16);
			memcpy(temp_block_aad, aad+16*(aad_len/16), aad_len - 16*(aad_len/16));
			bit_xor(intermediate_hash, temp_block_aad);
			gcm_mult(intermediate_hash, H,  temp_intermediate_hash);
			memcpy(intermediate_hash, temp_intermediate_hash, 16);
		}
	}
	else
	{
		uint8_t temp_intermediate_hash[16];

		gcm_mult(intermediate_hash, H,  temp_intermediate_hash);
		memcpy(intermediate_hash, temp_intermediate_hash, 16);
	}

	printf("\nX_0:");
	for(uint8_t i = 0; i < 16; i++)
		printf("%02X ", intermediate_hash[i]);

	for(uint8_t i = 0; i < in_ciphertext_len/16; i++)
	{
		bit_xor(intermediate_hash, in_ciphertext+16*i);

		uint8_t temp_intermediate_hash[16];
		gcm_mult(intermediate_hash, H,  temp_intermediate_hash);
		memcpy(intermediate_hash, temp_intermediate_hash, 16);

		printf("\nmult_%d: ", i+1);
		for(uint8_t i = 0; i < 16; i++)
			printf("%2X ", intermediate_hash[i]);
	}

	uint8_t remaining_bytes = in_ciphertext_len - 16 * (in_ciphertext_len/16);
	if(remaining_bytes > 0)
	{

		for(uint8_t i = 0; i < 16; i++)
		{
			if(i < remaining_bytes)
				intermediate_hash[i] ^= in_ciphertext[16*(in_ciphertext_len/16) + i];
			else
				intermediate_hash[i] ^= 0;
		}	

		uint8_t temp_intermediate_hash[16];
		gcm_mult(intermediate_hash, H,  temp_intermediate_hash);
		memcpy(intermediate_hash, temp_intermediate_hash, 16);
		
		printf("\nmult_last: ");
		for(uint8_t i = 0; i < 16; i++)
			printf("%2X ", intermediate_hash[i]);
	}

	uint64_t len_A = aad_len * 8;
	uint64_t len_C = in_ciphertext_len * 8;

	uint8_t temp_len_A_C[16];
	for(uint8_t i = 0 ; i < 8; i++)
		temp_len_A_C[i] = (uint8_t)(len_A >> (8*(7-i)));
	for(uint8_t i = 8 ; i < 16; i++)
		temp_len_A_C[i] = (uint8_t)(len_C >> (8*(15-i)));

	printf("\n len_AC: ");
	for(uint8_t i = 0; i < 16; i++)
	{
		intermediate_hash[i] ^= temp_len_A_C[i];
		printf("%2X ", temp_len_A_C[i]);
	}

	uint8_t tag[16];
	gcm_mult(intermediate_hash, H,  tag);
	printf("\nQHASH: ");
	for(uint8_t i = 0; i < 16; i++)
		printf("%2X ", tag[i]);

	for(uint8_t i = 0; i < 16; i++)
		tag[i] ^= temp_tag[i];

	for(uint8_t i = 0; i < 16; i++)
		if(tag[i] != in_tag[i])
			return -1;
	//=====================================================================


	// Both pointers used to point to the current position to process
	uint8_t *temp_plaintext = out_plaintext;
	uint8_t *temp_ciphertext = in_ciphertext;

	for(uint8_t block_nr = 0; block_nr < in_ciphertext_len/16; block_nr++)
	{
		iv_counter[15]++;

		// encrypt IV
		aes128_encrypt(iv_counter, key, temp_plaintext);
		// xor plaintext block with the above temporary ciphertext
		for(uint8_t i = 0; i < 16; i++)
			temp_plaintext[i] ^= temp_ciphertext[i];

			
		// move pointere to next 16-byte block
		temp_plaintext += 16;
		temp_ciphertext += 16;
	}

	// Check, if there exists some bytes (len < 16) needs to be decrypted
	remaining_bytes = in_ciphertext_len - 16 * (in_ciphertext_len/16);
	if(remaining_bytes > 0)
	{
		iv_counter[15]++;

		// encrypt IV
		aes128_encrypt(iv_counter, key, temp_plaintext);
		// xor plaintext block with the above temporary ciphertext
		for(uint8_t i = 0; i < remaining_bytes; i++)
			temp_plaintext[i] ^= temp_ciphertext[i];
	}

	return 0;
}


static void bit_xor(uint8_t *Z, uint8_t *V) {
  for(int i = 0; i < 16; i++) {
    Z[i] ^= V[i];
  }
}

void bit_shift_right(uint8_t *V) {

  for(uint8_t i = 15; i > 0; i--)
  {
	  uint8_t temp_bit = (V[i-1] & 0x01) << 7;
	  V[i] = temp_bit | (V[i] >> 1);
  }
	V[0] = V[0] >> 1;
}


void gcm_mult(uint8_t *X, uint8_t *Y,  uint8_t *Z) {

	uint8_t V[16];
	uint8_t shifter = 0x80;
	memset(Z, 0, 16);
	memcpy(V, Y, 16);

	for(int i = 0; i < 16; i++) {
		for(int j = 0; j < 8; j++) {
			if(X[i] & (shifter >> j)) {
				bit_xor(Z, V);
			}  
			else {
			} 

			if(V[15] & (0x01)) {
				/* R = 11100001 || 0^120 */
				bit_shift_right(V);
				V[0] ^= 0xe1;
			}  
			else {
				bit_shift_right(V);
			}

		}  
	}
}


int aes128_cbc_encrypt(uint8_t *iv, uint32_t length, uint8_t *key, uint8_t *input, uint8_t *output) {
  uint8_t temp[16];
  uint8_t temp_out[16];
  uint8_t temp_iv[16];
  uint8_t i;

  if(length % 16) {
    return ERR_INVALID_INPUT_LENGTH;
  }
  
  memcpy(temp_iv, iv, 16);
  while( length > 0 ) {   
    for( i = 0; i < 16; i++ ) {
      temp_out[i] = (uint8_t)( input[i] ^ temp_iv[i] );
    }
    aes128_encrypt(temp_out, key, output);
    memcpy(temp_iv, output, 16 );

    input  += 16;
    output += 16;
    length -= 16;
  }

  return SUCC_AES_CBC;
}

int aes128_cbc_decrypt(uint8_t *iv, uint32_t length, uint8_t *key, uint8_t *input, uint8_t *output) {
  uint8_t temp[16];
  uint8_t temp_iv[16];
  uint8_t i;

  if(length % 16) {
    return ERR_INVALID_INPUT_LENGTH;
  }

  memcpy(temp_iv, iv, 16);
  while( length > 0 ) {   
    memcpy( temp, input, 16 );
    aes128_decrypt(temp, key, output);
            
    for( i = 0; i < 16; i++ ) {
      output[i] = (uint8_t)( output[i] ^ temp_iv[i] );
    }            
    memcpy( temp_iv, input, 16 );
            
    input  += 16;
    output += 16;
    length -= 16;
  }

  return SUCC_AES_CBC;
}
